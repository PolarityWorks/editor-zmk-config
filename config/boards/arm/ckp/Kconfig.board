## config/boards/arm/ckp/Kconfig.board
```kconfig
# BT75 board configuration

# Copyright (c) 2021 Polarity Works
# SPDX-License-Identifier: MIT

config BOARD_CKP
	bool "ckp"
	depends on SOC_NRF52840_QIAA
```

## config/boards/arm/seventyfive/Kconfig.board
```kconfig
# BT75 board configuration

# Copyright (c) 2021 Polarity Works
# SPDX-License-Identifier: MIT

config BOARD_SEVENTYFIVE
	bool "seventyfive"
	depends on SOC_NRF52840_QIAA
```
